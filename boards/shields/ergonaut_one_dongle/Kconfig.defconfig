## boards/shields/ergonaut_one_dongle/Kconfig.defconfig
```kconfig
if SHIELD_ERGONAUT_ONE_DONGLE

config ZMK_SPLIT_BLE_CENTRAL_BATTERY_LEVEL_FETCHING
    default y

config ZMK_DISPLAY
    default y

choice ZMK_DISPLAY_STATUS_SCREEN
    default ZMK_DISPLAY_STATUS_SCREEN_CUSTOM
endchoice

config ZMK_DISPLAY_STATUS_SCREEN_CUSTOM
    select LV_USE_LABEL
    select LV_USE_BAR
    select LV_USE_FLEX
    select LV_USE_ROLLER
    select LV_COLOR_SCREEN_TRANSP

choice ZMK_DISPLAY_WORK_QUEUE
    default ZMK_DISPLAY_WORK_QUEUE_DEDICATED
endchoice

config ZMK_DISPLAY_DEDICATED_THREAD_STACK_SIZE
    default 4096

choice ST7789V_PIXEL_FORMAT
    default ST7789V_RGB565
endchoice

config LV_Z_VDB_SIZE
    int
    default 20

config LV_Z_MEM_POOL_SIZE
    int
    default 10000

config LV_DPI_DEF
    int
    default 261

config LV_Z_BITS_PER_PIXEL
    int
    default 16

choice LV_COLOR_DEPTH
    default LV_COLOR_DEPTH_16
endchoice

config LV_COLOR_16_SWAP
    bool
    default y

config LV_DISP_DEF_REFR_PERIOD
    int
    default 20

choice LV_FONT_DEFAULT
    default LV_FONT_DEFAULT_MONTSERRAT_20
endchoice

config PWM
    bool
    default y

config LED
    bool
    default y

config PROSPECTOR_USE_AMBIENT_LIGHT_SENSOR
    bool
    default n

config PROSPECTOR_FIXED_BRIGHTNESS
    int
    default 100

endif
```

## config/boards/shields/ergonaut_one/Kconfig.defconfig
```kconfig
if SHIELD_ERGONAUT_ONE_DONGLE

config ZMK_KEYBOARD_NAME
    default "Ergonaut One Dongle"

config ZMK_SPLIT_ROLE_CENTRAL
    default y

config ZMK_SPLIT
    default y

config ZMK_SPLIT_BLE_CENTRAL_PERIPHERALS
    default 2

config ZMK_SPLIT_BLE_CENTRAL_BATTERY_LEVEL_FETCHING
    default y

config BT_MAX_CONN
    default 7

config BT_MAX_PAIRED
    default 7

config ZMK_DISPLAY
    default y

choice ZMK_DISPLAY_WORK_QUEUE
    default ZMK_DISPLAY_WORK_QUEUE_DEDICATED
endchoice

config ZMK_DISPLAY_DEDICATED_THREAD_STACK_SIZE
    int
    default 4096

config ZMK_DISPLAY_INIT_PRIORITY
    int
    default 80

choice ST7789V_PIXEL_FORMAT
    default ST7789V_RGB565
endchoice

choice LV_COLOR_DEPTH
    default LV_COLOR_DEPTH_16
endchoice

choice LV_FONT_DEFAULT
    default LV_FONT_DEFAULT_MONTSERRAT_20
endchoice

config PWM
    default y

config LED
    default y

endif
```

## config/boards/shields/ergonaut_one_dongle/Kconfig.defconfig
```kconfig
if SHIELD_ERGONAUT_ONE_DONGLE

config ZMK_KEYBOARD_NAME
    default "Ergonaut Dongle"

if ZMK_BACKLIGHT
config PWM
    default y

config LED_PWM
    default y
endif # ZMK_BACKLIGHT

endif # SHIELD_ERGONAUT_ONE_DONGLE
```

## config/modules/Kconfig.defconfig
```kconfig
if SHIELD_ERGONAUT_ONE_DONGLE

config ZMK_KEYBOARD_NAME
    default "Ergonaut Dongle"

endif # SHIELD_ERGONAUT_ONE_DONGLE
```

## config/west.yml
```yaml
manifest:
  remotes:
    - name: zmkfirmware
      url-base: https://github.com/zmkfirmware
    - name: ergonautkb
      url-base: https://github.com/ergonautkb
    - name: carrefinho
      url-base: https://github.com/carrefinho
    - name: jeremyp9110
      url-base: https://github.com/jeremyp9110
  projects:
    - name: zmk
      remote: zmkfirmware
      revision: main
      import: app/west.yml
    - name: ergonautkb-zmk-module
      remote: ergonautkb
      revision: main
    - name: prospector-zmk-module                 # <--- and these
      remote: carrefinho                          # <---
      revision: feat/new-status-screens 
  self:
    path: .
```

## dts/bindings/display/sitronix,st7789v.yaml
```yaml
description: Binding personnalisé ST7789V sur bus SPI direct

compatible: "zmk,st7789v"

include: [display-controller.yaml, spi-device.yaml]

properties:
  cmd-data-gpios:
    type: phandle-array
    required: true
    description: Broche GPIO Commande/Data (DC)

  reset-gpios:
    type: phandle-array
    description: Broche GPIO de Réinitialisation

  width:
    type: int
    required: true

  height:
    type: int
    required: true

  x-offset:
    type: int

  y-offset:
    type: int

  vcom:
    type: int

  gctrl:
    type: int

  vrhs:
    type: int

  vdvs:
    type: int

  mdac:
    type: int

  gamma:
    type: int

  colmod:
    type: int

  lcm:
    type: int

  porch-param:
    type: uint8-array

  cmd2en-param:
    type: uint8-array

  pwctrl1-param:
    type: uint8-array

  pvgam-param:
    type: uint8-array

  nvgam-param:
    type: uint8-array

  ram-param:
    type: uint8-array

  rgb-param:
    type: uint8-array
```
